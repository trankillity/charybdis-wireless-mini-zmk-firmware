## config/west.yml
```yaml
manifest:
  remotes:
    - name: zmkfirmware
      url-base: https://github.com/zmkfirmware

    - name: 280Zo
      url-base: https://github.com/280Zo

    - name: dhruvinsh
      url-base: https://github.com/dhruvinsh

    - name: oleksandrmaslov
      url-base: https://github.com/oleksandrmaslov

  projects:
    - name: zmk
      remote: zmkfirmware
      revision: v0.3.0
      import: app/west.yml

    - name: zmk-pmw3610-driver
      remote: 280Zo
      revision: main

    - name: zmk-tri-state
      remote: dhruvinsh
      revision: main

    - name: zmk-pointing-acceleration
      remote: oleksandrmaslov
      revision: main

  self:
    path: config
```
