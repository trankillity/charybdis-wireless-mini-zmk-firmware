#include <input/processors.dtsi>
#include <dt-bindings/zmk/input_transform.h>

&trackball_listener {
    /* base processor chain on all layers */
    input-processors = <&zip_xy_scaler 1 1>;

    /* Mouse layer slow-pointer override */
    slow_pointer: slow_pointer {
        layers           = <4>;
        input-processors = <&zip_xy_scaler 1 2>;
    };

    /* Scroll layer override */
    scroller: scroller {
        layers           = <5>;
        input-processors = <
            &zip_xy_scaler 1 4                               // Scales the scroll speed
            &zip_xy_to_scroll_mapper                         // Converts XY movement to scroll events
            &zip_scroll_transform (INPUT_TRANSFORM_Y_INVERT) // Inverts the scroll direction
        >;
    };
};